## CMakeLists.txt
```
# SPDX-License-Identifier: Apache-2.0
cmake_minimum_required(VERSION 3.20.0)

find_package(Zephyr REQUIRED HINTS $ENV{ZEPHYR_BASE})
project(dongle_nrf52840)

# 复用 Zephyr 的 sample_usbd 初始化辅助（新 USB 设备栈的描述符/配置装配）
include(${ZEPHYR_BASE}/samples/subsys/usb/common/common.cmake)

if(CONFIG_APP_ESB)
  # 2.4G ESB 变体：esb_rx.c 收到鼠标 PTX 的包后塞 rep_q，main.c 照常提交 HID
  target_sources(app PRIVATE
    src/main.c
    src/esb_rx.c
    src/hid_cfg.c
  )
else()
  target_sources(app PRIVATE
    src/main.c
    src/ble_ctr.c
    src/hid_cfg.c
  )
endif()
```

## Kconfig
```
# XIAO 2.4G dongle（ProMicro nRF52840）

mainmenu "XIAO 2.4G dongle"

config APP_ESB
	bool "Use 2.4G ESB PRX instead of BLE central"
	default n

# sample_usbd_init.c 用到的描述符选项（自备一套，避免依赖 Zephyr sample 树）
menu "USB descriptor options"
	depends on USB_DEVICE_STACK_NEXT

config SAMPLE_USBD_MANUFACTURER
	string "USB manufacturer string"
	default "xiao-fw"

config SAMPLE_USBD_PRODUCT
	string "USB product string"
	default "XIAO 2.4G Dongle"

config SAMPLE_USBD_VID
	hex "USB Vendor ID"
	default 0x1915

config SAMPLE_USBD_PID
	hex "USB Product ID"
	default 0x4242

config SAMPLE_USBD_SELF_POWERED
	bool "Self-powered attribute"
	default n

config SAMPLE_USBD_REMOTE_WAKEUP
	bool "Remote wakeup attribute"
	default n

config SAMPLE_USBD_MAX_POWER
	int "bMaxPower (2 mA units)"
	default 125

config SAMPLE_USBD_20_EXTENSION_DESC
	bool "USB 2.0 Extension Descriptor"
	default n
	depends on USBD_BOS_SUPPORT

endmenu

source "Kconfig.zephyr"
```

## prj.conf
```kconfig
# ---- USB（新设备栈）：HID 鼠标 + CDC 控制台 复合设备 ----
CONFIG_USB_DEVICE_STACK_NEXT=y
CONFIG_USBD_HID_SUPPORT=y
CONFIG_USBD_CDC_ACM_CLASS=y
# 注意：必须保持 n（与 hid-mouse sample 一致）。
# 开了 at-boot 会让 CDC 类实例先于 usbd_register_all_classes 初始化，
# 实测导致类注册失败/枚举反复总线复位。
CONFIG_CDC_ACM_SERIAL_INITIALIZE_AT_BOOT=n

# 定位类注册失败：开 USB 核心调试日志（已确认正常，降回 WRN 降噪）
CONFIG_USBD_LOG_LEVEL_WRN=y
CONFIG_USBD_HID_LOG_LEVEL_WRN=y

# ---- BLE 主机（替代 ESB 2.4G）----
# dongle 主动连接鼠标并订阅 HID 通知，再转成本机 USB HID。
CONFIG_BT=y
CONFIG_BT_CENTRAL=y
CONFIG_BT_GATT_CLIENT=y
CONFIG_BT_SMP=y
CONFIG_BT_MAX_CONN=1
CONFIG_BT_DEVICE_NAME="XIAO Dongle"
# 鼠标侧 HID 上报要求加密，这里关掉自动安全请求，由初始化流程主动升级
CONFIG_BT_GATT_AUTO_SEC_REQ=n
CONFIG_BT_AUTO_PHY_UPDATE=n
# 预留 Nordic 私有 LLPM（1 ms）能力
CONFIG_BT_CTLR_SDC_LLPM=y
# LLPM 1 ms 要求连接事件长度不超过间隔；默认 7500 us 会让控制器拒绝 1 ms。
CONFIG_BT_CTLR_SDC_MAX_CONN_EVENT_LEN_DEFAULT_OVERRIDE=y
CONFIG_BT_CTLR_SDC_MAX_CONN_EVENT_LEN_DEFAULT=1000

# ---- 配对持久化：dongle 必须记住 LTK ----
# 否则每次重新上电都丢掉密钥，会重新发起配对；而鼠标侧还留着旧绑定，
# Zephyr 的 update_keys_check() 会以 AUTH_REQUIREMENTS(0x04) 拒绝重配。
# 板级 DTS 已经在 0xEC000 定义了 32 KB 的 storage_partition，直接用。
CONFIG_SETTINGS=y
CONFIG_BT_SETTINGS=y
CONFIG_NVS=y
CONFIG_SETTINGS_NVS=y
CONFIG_FLASH=y
CONFIG_FLASH_MAP=y
CONFIG_FLASH_PAGE_LAYOUT=y
CONFIG_MPU_ALLOW_FLASH_WRITE=y

# ---- 控制台：printk / log 走 USB CDC 虚拟串口 ----
CONFIG_SERIAL=y
CONFIG_CONSOLE=y
CONFIG_UART_CONSOLE=y
CONFIG_PRINTK=y
CONFIG_LOG=y

# ---- 其它 ----
CONFIG_GPIO=y
CONFIG_HWINFO=y

# ---- USB 描述符 ----
# VID 用 Nordic 的 0x1915（开发阶段惯例），PID 自选；量产前需换正式 VID/PID
CONFIG_SAMPLE_USBD_PID=0x4242
```

## prj_esb.conf
```kconfig
# ---- XIAO 2.4G dongle：ESB PRX 变体（配合鼠标端 prj_esb.conf） ----
#
# 与 BLE 版共用 main.c / USB HID 布局，只把接收层换成 ESB：
#   鼠标 PTX --2.4G--> 本机 PRX --> USB HID --> 电脑
# 该变体不含蓝牙，烧录后 BLE 版要重新构建 build 目录才能回去。

# ---- USB（新设备栈）：HID 鼠标 + CDC 控制台 复合设备 ----
CONFIG_USB_DEVICE_STACK_NEXT=y
CONFIG_USBD_HID_SUPPORT=y
CONFIG_USBD_CDC_ACM_CLASS=y
CONFIG_CDC_ACM_SERIAL_INITIALIZE_AT_BOOT=n

CONFIG_USBD_LOG_LEVEL_WRN=y
CONFIG_USBD_HID_LOG_LEVEL_WRN=y

# ---- 2.4G ESB PRX ----
# 选择 ESB 变体（CMake 据此编译 esb_rx.c 而非 ble_ctr.c）
CONFIG_APP_ESB=y
CONFIG_ESB=y
# ESB 库自己拉起 HF 时钟（nRF52840 走 CLOCK_CONTROL_NRF 分支）
CONFIG_ESB_CLOCK_INIT=y
# 负载 10 字节，默认 32 足够；RX FIFO 加深一点，1 kHz 下留缓冲
CONFIG_ESB_RX_FIFO_SIZE=16

# ---- 配置持久化（厂商 HID 通道的设置存 NVS）----
# 板级 DTS（uf2 变体）在 0xEC000 定义了 32 KB storage_partition
CONFIG_SETTINGS=y
CONFIG_NVS=y
CONFIG_SETTINGS_NVS=y
CONFIG_FLASH=y
CONFIG_FLASH_MAP=y
CONFIG_FLASH_PAGE_LAYOUT=y
CONFIG_MPU_ALLOW_FLASH_WRITE=y

# ---- 控制台：printk / log 走 USB CDC 虚拟串口 ----
CONFIG_SERIAL=y
CONFIG_CONSOLE=y
CONFIG_UART_CONSOLE=y
CONFIG_PRINTK=y
CONFIG_LOG=y

# ---- 其它 ----
CONFIG_GPIO=y
# 低电呼吸灯：走板载 pwm0（P0.15），用 pwm-leds 硬件调光
CONFIG_PWM=y
CONFIG_LED=y
CONFIG_LED_PWM=y
CONFIG_HWINFO=y

# ---- USB 描述符 ----
CONFIG_SAMPLE_USBD_PID=0x4242
```

## app.overlay
```dts
/*
 * HID 设备实例：1 ms 轮询周期，4 字节鼠标报告（btn, dx, dy, wheel）
 */

#include <zephyr/dt-bindings/pwm/pwm.h>

/*
 * 板级 pwmleds 给 red_pwm_led 标了 PWM_POLARITY_INVERTED，但这块 ProMicro
 * 的红灯是高点平点亮（gpio-leds 也标的 GPIO_ACTIVE_HIGH）。极性标反会让
 * brightness=0 变成常亮，这里改回正常极性。
 */
&red_pwm_led {
	pwms = <&pwm0 0 PWM_MSEC(20) PWM_POLARITY_NORMAL>;
};

/ {
	hid_dev_0: hid_dev_0 {
		compatible = "zephyr,hid-device";
		label = "HID0";
		protocol-code = "none";
		in-polling-period-us = <1000>;
		in-report-size = <64>;
	};
};
```

## src/main.c
```c
/*
 * XIAO 2.4G dongle —— ProMicro nRF52840
 *
 * 阶段 A：USB HID 鼠标 + CDC 控制台复合设备（已验证：枚举 + 测试信号端到端）
 * 阶段 B：ESB PRX（2.4G 接收）——鼠标端 PTX 发包，这里收包后提交 HID
 *
 * 报告布局（Report ID 1，6 字节数据）：
 *   [0] Report ID（0x01，由本文件在提交时补上）
 *   [1] 按键位图（bit0=左键, bit1=右键, bit2=中键）
 *   [2..3] dx (int16 LE)
 *   [4..5] dy (int16 LE)
 *   [6] wheel (int8)
 *
 * 位移用 16 位：高 DPI 下单包位移经常超过 127，8 位会把移动"削平"，
 * 表现为甩不动、手感发涩（实测 4800 DPI 必现）。
 *
 * 注意：厂商配置通道用了 Feature Report ID 0x06，按 HID 规范只要出现
 * Report ID，所有报告都必须带 ID，因此鼠标报告也从"无 ID"改成了 ID 1
 * （无 ID + 有 ID 混用时 Windows 会直接报 Code 10，HID 驱动起不来）。
 *
 * 链路状态指示（led0 红灯）：
 *   收包中 = 常亮；静默超过 200 ms = 熄灭
 */

#include <sample_usbd.h>

#include <errno.h>
#include <string.h>

#include <zephyr/kernel.h>
#include <zephyr/device.h>
#include <zephyr/drivers/gpio.h>
#include <zephyr/drivers/led.h>
#include <zephyr/sys/util.h>
#include <zephyr/sys/printk.h>

#include <zephyr/usb/usbd.h>
#include <zephyr/usb/class/usbd_hid.h>

#if defined(CONFIG_APP_ESB)
#include "esb_rx.h"
#else
#include "ble_ctr.h"
#endif

#include "hid_cfg.h"

#ifndef APP_VERBOSE_LOG
#define APP_VERBOSE_LOG 0
#endif

#if defined(CONFIG_APP_ESB)
static int ctl_init(void)
{
	return esb_rx_init();
}

static void ctl_stats(uint32_t *total, uint32_t *err)
{
	esb_rx_stats(total, err);
}

static int64_t ctl_last_ms(void)
{
	return esb_rx_last_ms();
}

static int ctl_battery_level(void)
{
	/* ESB 没有 BAS，电量由鼠标搭在数据包 data[9] 上回传 */
	return esb_rx_battery_level();
}
#else
static int ctl_init(void)
{
	return ble_ctr_init();
}

static void ctl_stats(uint32_t *total, uint32_t *err)
{
	ble_ctr_stats(total, err);
}

static int64_t ctl_last_ms(void)
{
	return ble_ctr_last_ms();
}

static int ctl_battery_level(void)
{
	return ble_ctr_battery_level();
}
#endif

#if !defined(CONFIG_APP_ESB)
static const struct gpio_dt_spec led =
	GPIO_DT_SPEC_GET(DT_ALIAS(led0), gpios);
#endif

/* 报告描述符：标准鼠标 + 厂商配置通道。
 *
 * 鼠标输入报告用 **Report ID 1**（厂商 Feature Report 是 ID 6）。
 * HID 规范要求：描述符里一旦出现 Report ID，所有报告都必须带 ID，
 * 否则 Windows 直接把 HID 设备判成 Code 10。所以提交报告时要先补一个
 * 0x01 字节，见主循环里的 hid_device_submit_report()。
 *
 * 内容与 Zephyr 的 HID_MOUSE_REPORT_DESC(5) 完全一致（5 键 + 3 位填充），
 * 只是多了一行 Report ID，无法直接复用那个宏（它自带花括号，不能追加）。
 *
 * 后半段是 Feature Report ID 0x06（32 字节），协议见 hid_cfg.h，
 * PC 驱动用 HidD_GetFeature/SetFeature 读写。
 */
#define HID_REPORT_ID_MOUSE  0x01
static const uint8_t hid_report_desc[] = {
	HID_USAGE_PAGE(HID_USAGE_GEN_DESKTOP),
	HID_USAGE(HID_USAGE_GEN_DESKTOP_MOUSE),
	HID_COLLECTION(HID_COLLECTION_APPLICATION),
		0x85, HID_REPORT_ID_MOUSE,   /* Report ID (1) —— 见文件头说明 */
		HID_USAGE(HID_USAGE_GEN_DESKTOP_POINTER),
		HID_COLLECTION(HID_COLLECTION_PHYSICAL),
			HID_USAGE_PAGE(HID_USAGE_GEN_BUTTON),
			HID_USAGE_MIN8(1),
			HID_USAGE_MAX8(5),
			HID_LOGICAL_MIN8(0),
			HID_LOGICAL_MAX8(1),
			HID_REPORT_SIZE(1),
			HID_REPORT_COUNT(5),
			HID_INPUT(0x02),
			HID_REPORT_SIZE(3),
			HID_REPORT_COUNT(1),
			HID_INPUT(1),
			HID_USAGE_PAGE(HID_USAGE_GEN_DESKTOP),
			HID_USAGE(HID_USAGE_GEN_DESKTOP_X),
			HID_USAGE(HID_USAGE_GEN_DESKTOP_Y),
			HID_LOGICAL_MIN16(0x01, 0x80),   /* -32767 */
			HID_LOGICAL_MAX16(0xFF, 0x7F),   /*  32767 */
			HID_REPORT_SIZE(16),
			HID_REPORT_COUNT(2),
			HID_INPUT(0x06),
			HID_USAGE(HID_USAGE_GEN_DESKTOP_WHEEL),
			HID_LOGICAL_MIN8(-127),
			HID_LOGICAL_MAX8(127),
			HID_REPORT_SIZE(8),
			HID_REPORT_COUNT(1),
			HID_INPUT(0x06),
		HID_END_COLLECTION,
	HID_END_COLLECTION,

	/* ---- 厂商配置通道：Feature Report ID 0x06，32 字节 ---- */
	0x06, 0x00, 0xFF,          /* Usage Page (Vendor Defined 0xFF00) */
	0x09, 0x01,                /* Usage (0x01) */
	0xA1, 0x01,                /* Collection (Application) */
	0x85, HID_CFG_REPORT_ID,   /*   Report ID (6) */
	0x09, 0x02,                /*   Usage (0x02) */
	0x15, 0x00,                /*   Logical Minimum (0) */
	0x26, 0xFF, 0x00,          /*   Logical Maximum (255) */
	0x75, 0x08,                /*   Report Size (8) */
	0x95, HID_CFG_REPORT_LEN,  /*   Report Count (32) */
	0xB1, 0x02,                /*   Feature (Data,Var,Abs) */
	0xC0,                      /* End Collection */
};

enum report_idx {
	REP_BTN = 0,
	REP_XL,
	REP_XH,
	REP_YL,
	REP_YH,
	REP_WHEEL,
	REP_COUNT,
};

/* 上报队列：ESB RX 回调（中断上下文）填充，主循环消费。
 * 1 kHz 下 32 ms 缓冲，满了丢旧包（位移只关心最新状态） */
K_MSGQ_DEFINE(rep_q, REP_COUNT, 32, 1);

/* USB 回调（中断/系统线程上下文）写、主循环读，必须 volatile，
 * 否则优化后主循环可能一直看到缓存的 false 而丢掉所有报告。 */
static volatile bool hid_ready;

/* 电量低于该值就呼吸红灯（鼠标现在始终回传真实电量） */
#define LOW_BATTERY_PCT 25

#if defined(CONFIG_APP_ESB)
/* 低电呼吸灯：pwm-leds 跑在独立线程，避免占住 1 kHz 主循环。
 * 三角波 0→100→0，周期 2 s，每 20 ms 一步；电量正常时保持全灭。
 *
 * 两处防抖，避免"还没到 25% 就开始亮"：
 *   LOW_BATTERY_CONFIRM_MS：电量 ≤25% 要连续保持 15 s 才点亮
 *                           （鼠标 5 s 报一次，即 3 次读数确认，滤掉负载压降）
 *   LOW_BATTERY_HYST      ：点亮后要回到 27% 以上才熄灭，防止临界值闪烁
 */
#define BREATH_STEP_MS 20
#define BREATH_PERIOD_MS 2000
#define LOW_BATTERY_CONFIRM_MS 15000
#define LOW_BATTERY_HYST 2

/* pwm-leds 的设备节点是父节点 /pwmleds，子节点只是通道；
 * 别名指向子节点，所以要往上取一层，通道号按子节点序号。
 */
static const struct device *const batt_led =
	DEVICE_DT_GET(DT_PARENT(DT_ALIAS(pwm_led0)));
#define BATT_LED_CHANNEL DT_NODE_CHILD_IDX(DT_ALIAS(pwm_led0))

static void batt_led_thread(void *a, void *b, void *c)
{
	ARG_UNUSED(a);
	ARG_UNUSED(b);
	ARG_UNUSED(c);

	if (!device_is_ready(batt_led)) {
		printk("batt led not ready\n");
		return;
	}

	uint32_t phase = 0;
	int64_t low_since = 0;
	bool low_lit = false;

	while (true) {
		int pct = ctl_battery_level();

		/* 点亮门槛 25%，熄灭门槛 27%（已点亮时） */
		int off_above = low_lit ? (LOW_BATTERY_PCT + LOW_BATTERY_HYST)
				       : LOW_BATTERY_PCT;
		bool low = (pct > 0 && pct <= off_above);

		if (!low) {
			(void)led_set_brightness(batt_led, BATT_LED_CHANNEL, 0);
			phase = 0;
			low_since = 0;
			low_lit = false;
			k_msleep(200);
			continue;
		}

		if (!low_lit) {
			int64_t now = k_uptime_get();

			if (low_since == 0) {
				low_since = now;
			}
			if ((now - low_since) < LOW_BATTERY_CONFIRM_MS) {
				(void)led_set_brightness(batt_led, BATT_LED_CHANNEL, 0);
				phase = 0;
				k_msleep(BREATH_STEP_MS);
				continue;
			}
			low_lit = true;
		}

		uint32_t half = BREATH_PERIOD_MS / 2;
		uint8_t bright = (uint8_t)((phase < half)
			? (phase * 100 / half)
			: ((BREATH_PERIOD_MS - phase) * 100 / half));

		(void)led_set_brightness(batt_led, BATT_LED_CHANNEL, bright);
		phase = (phase + BREATH_STEP_MS) % BREATH_PERIOD_MS;
		k_msleep(BREATH_STEP_MS);
	}
}

K_THREAD_DEFINE(batt_led_tid, 1536, batt_led_thread, NULL, NULL, NULL, 7, 0, 0);
#endif

/* 链路空闲判定：超过该时长没收到包就算空闲（只用于打印，不再驱动灯）。
 * 鼠标静止时只有 500 ms 一次的保活包，窗口必须比它大，否则日志每几秒
 * 就 link up/link idle 刷一对。 */
#define LINK_IDLE_MS 1500

/* ---- HID 回调 ---- */
static void iface_ready(const struct device *dev, const bool ready)
{
	printk("usb: HID iface %s\n", ready ? "ready" : "not ready");
	hid_ready = ready;
}

static int get_report(const struct device *dev,
		      const uint8_t type, const uint8_t id, const uint16_t len,
		      uint8_t *const buf)
{
	ARG_UNUSED(dev);

	if (type == HID_REPORT_TYPE_FEATURE && id == HID_CFG_REPORT_ID) {
		return hid_cfg_get_report(buf, len);
	}

	return -ENOTSUP;
}

static int set_report(const struct device *dev,
		      const uint8_t type, const uint8_t id, const uint16_t len,
		      const uint8_t *const buf)
{
	ARG_UNUSED(dev);

	if (type == HID_REPORT_TYPE_FEATURE && id == HID_CFG_REPORT_ID) {
		return hid_cfg_set_report(buf, len);
	}

	return -ENOTSUP;
}

static const struct hid_device_ops hid_ops = {
	.iface_ready = iface_ready,
	.get_report = get_report,
	.set_report = set_report,
};

int main(void)
{
	struct usbd_context *usbd;
	const struct device *hid_dev;
	int ret;

#if defined(CONFIG_APP_ESB)
	printk("\n=== XIAO 2.4G dongle (ESB PRX + USB HID) ===\n");
#else
	printk("\n=== XIAO 2.4G dongle (BLE central + USB HID) ===\n");
#endif
	printk("build: %s %s\n\n", __DATE__, __TIME__);

#if !defined(CONFIG_APP_ESB)
	if (!gpio_is_ready_dt(&led)) {
		printk("led not ready\n");
		return 0;
	}
	(void)gpio_pin_configure_dt(&led, GPIO_OUTPUT_INACTIVE);
#endif

	ret = ctl_init();
	if (ret != 0) {
		printk("link init failed (%d), continuing USB-only\n", ret);
	}

	hid_dev = DEVICE_DT_GET_ONE(zephyr_hid_device);
	if (!device_is_ready(hid_dev)) {
		printk("HID device not ready\n");
		return -EIO;
	}

	/* 配置通道要早于 USB 使能：主机枚举完就可能立刻读 Feature Report */
	hid_cfg_init();

	ret = hid_device_register(hid_dev,
				  hid_report_desc, sizeof(hid_report_desc),
				  &hid_ops);
	if (ret != 0) {
		printk("hid_device_register failed (%d)\n", ret);
		return ret;
	}

	usbd = sample_usbd_init_device(NULL);
	if (usbd == NULL) {
		printk("usbd init failed\n");
		return -ENODEV;
	}

	ret = usbd_enable(usbd);
	if (ret != 0) {
		printk("usbd_enable failed (%d)\n", ret);
		return ret;
	}

#if defined(CONFIG_APP_ESB)
	printk("usb: started, waiting for ESB packets\n");
#else
	printk("usb: started, waiting for BLE HID notifications\n");
#endif

	uint32_t sent_total = 0;
	uint32_t hid_busy = 0;
	uint32_t usb_btn = 0;   /*  Diagnostics: 提交到 USB 的"有按键"报告数 */
	uint32_t rx_total = 0;
	uint32_t rx_err = 0;
	uint32_t rx_win0 = 0;
	int64_t stat_t0 = k_uptime_get();
	bool link_fresh = false;
	int64_t led_t0 = 0;
	bool led_on = false;
	/* USB 侧没送出去的滚轮格数。USB 每 1 ms 只取最新一份报告，
	 * 提交失败时如果不补偿，这一格滚轮就永久丢了。
	 * 下一份报告把欠的格数一起带上（饱和到 ±127，余量继续留）。 */
	int32_t wheel_retry = 0;

	while (true) {
		uint8_t rep[REP_COUNT];

		/* 把 PC 端改过的设置推给鼠标（内部按 20 ms 节流，链路断开时自动挂起） */
		hid_cfg_poll();

		/* 100 ms 超时兜底：链路静默时也要维护灯和统计 */
		if (k_msgq_get(&rep_q, rep, K_MSEC(100)) == 0) {
			if (!hid_ready) {
				/* USB 还没枚举好，报告被丢弃；滚轮先记下来 */
				wheel_retry = CLAMP(wheel_retry + (int8_t)rep[REP_WHEEL],
						    -32767, 32767);
			} else {
				uint8_t report[REP_COUNT + 1];
				int32_t w = (int8_t)rep[REP_WHEEL] + wheel_retry;
				int32_t w_send = CLAMP(w, -127, 127);

				/* 描述符里用了 Report ID，所以每条报告首字节都要带 ID */
				report[0] = HID_REPORT_ID_MOUSE;
				memcpy(&report[1], rep, REP_COUNT);
				report[1 + REP_WHEEL] = (uint8_t)(int8_t)w_send;

				ret = hid_device_submit_report(hid_dev, sizeof(report), report);
				if (ret != 0) {
					hid_busy++;
					/* 提交失败：这份滚轮没送到主机，累计到下一次 */
					wheel_retry = CLAMP(wheel_retry +
							    (int8_t)rep[REP_WHEEL],
							    -32767, 32767);
				} else {
					sent_total++;
					/* 成功：只扣掉实际送出的部分，饱和的余量留下 */
					wheel_retry = CLAMP(w - w_send, -32767, 32767);
					if (rep[0] & 0x1f) {
						usb_btn++;
					}
				}
			}
		}

		/* ---- 链路状态 + 统计（每 100 ms 维护一次） ---- */
		uint32_t now_total;
		uint32_t now_err;

		ctl_stats(&now_total, &now_err);
		rx_total = now_total;
		rx_err = now_err;

		bool fresh = (rx_total > 0) &&
			     ((k_uptime_get() - ctl_last_ms()) <= LINK_IDLE_MS);

		if (fresh != link_fresh) {
			link_fresh = fresh;
			printk("link %s\n", fresh ? "up" : "idle");
		}

		/* LED：ESB 变体由 batt_led_thread 做低电呼吸；
		 * 这里只维护统计用的 led_on 状态。BLE 变体仍用 GPIO 常亮。
		 */
		if ((k_uptime_get() - led_t0) >= 1000) {
			int pct = ctl_battery_level();

			led_on = (pct > 0 && pct <= LOW_BATTERY_PCT);
#if !defined(CONFIG_APP_ESB)
			(void)gpio_pin_set_dt(&led, led_on);
#endif
			led_t0 = k_uptime_get();
		}

		if ((k_uptime_get() - stat_t0) >= 5000) {
#if defined(CONFIG_APP_ESB)
#if APP_VERBOSE_LOG
			printk("esb: rx %u in 5 s (tot %u, err %u) | hid sent %u (busy %u) | btn usb %u | bat %d%% led %d\n",
			       (unsigned int)(rx_total - rx_win0), rx_total, rx_err,
			       sent_total, hid_busy, (unsigned int)usb_btn,
			       ctl_battery_level(), led_on ? 1 : 0);
#endif
#else
			uint32_t sec_ok, sec_err, disc_ok, sub_ok, disc_evt;
			uint32_t bdisc, bfound, bchr, brok, brerr;

			ble_ctr_diag(&sec_ok, &sec_err, &disc_ok, &sub_ok, &disc_evt);
			ble_ctr_bas_diag(&bdisc, &bfound, &bchr, &brok, &brerr);
#if APP_VERBOSE_LOG
			printk("ble: rx %u in 5 s (tot %u, err %u) | hid sent %u (busy %u) | btn rx %u usb %u | bat %d%% led %d | sec %u/%u disc %u sub %u dc %u | bas %u/%u/%u/%u/%u\n",
			       (unsigned int)(rx_total - rx_win0), rx_total, rx_err,
			       sent_total, hid_busy,
			       (unsigned int)ble_ctr_btn_count(), (unsigned int)usb_btn,
			       ble_ctr_battery_level(), led_on ? 1 : 0,
			       (unsigned int)sec_ok, (unsigned int)sec_err,
			       (unsigned int)disc_ok, (unsigned int)sub_ok,
			       (unsigned int)disc_evt,
			       (unsigned int)bdisc, (unsigned int)bfound,
			       (unsigned int)bchr, (unsigned int)brok,
			       (unsigned int)brerr);
#endif
#endif
			stat_t0 = k_uptime_get();
			rx_win0 = rx_total;
		}
	}

	return 0;
}
```

## src/ble_ctr.c
```c
/*
 * BLE Central 接收层（dongle 侧）实现
 *
 * 流程：扫描 "XIAO Mouse" -> 连接 -> 提升到 L2 加密 -> 发现 HID 服务
 *       -> 发现 Report 特征 -> 逐个订阅 -> 解析通知 -> 投递 rep_q
 *
 * 报告解析（HID over GATT，特征值首字节是 Report ID）：
 *   ID 1: [1, btn, wheel, pan]          -> 按键 / 滚轮 / 横向
 *   ID 2: [2, x_lo, xhi_y_lo, y_hi]    -> X/Y 各 12 bit 有符号
 * 合成 dongle 的 4 字节 USB 报告：{btn, dx, dy, wheel}
 */

#include <string.h>

#include <zephyr/kernel.h>
#include <zephyr/sys/printk.h>
#include <zephyr/sys/atomic.h>
#include <zephyr/bluetooth/bluetooth.h>
#include <zephyr/bluetooth/conn.h>
#include <zephyr/bluetooth/gatt.h>
#include <zephyr/bluetooth/hci.h>
#include <zephyr/bluetooth/uuid.h>
#include <zephyr/settings/settings.h>
#if defined(CONFIG_BT_CTLR_SDC_LLPM)
#include <bluetooth/hci_vs_sdc.h>
#endif

#include "ble_ctr.h"

/* 与 main.c 共享的 USB HID 报告队列（6 字节：btn, dxL, dxH, dyL, dyH, wheel） */
extern struct k_msgq rep_q;

#define REP_LEN 6

static struct bt_conn *conn;
static atomic_t rx_total;
static atomic_t rx_err;
static atomic_t last_rx_ms;
static volatile bool subscribed;

/* GATT 发现状态 */
static struct bt_gatt_discover_params disc;
static uint16_t hid_start;
static uint16_t hid_end;
static uint16_t rep_handles[4];
static int rep_cnt;

/* 订阅参数：最多两个 Report 特征（按键 / 位移） */
static struct bt_gatt_subscribe_params subs[4];

/* 订阅结果/重试状态（订阅回调只能靠它判断 CCCD 写入是否真的成功） */
static atomic_t sub_failed;
static uint8_t sub_retries;

/* 每连接只做一次发现 / 一次订阅。
 * 重复调用会踩两个坑：一是发现状态机被同一个 disc 结构并发复用，
 * 二是 repeat 订阅会把协议栈里的订阅链表搞乱（见 subscribe_reports 的说明）。
 */
static bool disc_started;
static bool subs_started;

/* 累计收到的按键报告数（诊断用，非阻塞） */
static atomic_t btn_cnt;

/* ---- 电量（标准 Battery Service 0x180F / 0x2A19）----
 * 鼠标把电量挂到 BAS 上（见鼠标 prj.conf 的 CONFIG_BT_BAS），
 * dongle 连上后先读一次当前值，再订阅后续变化，用来驱动红灯做低电提示。
 * 这里先做声明，具体实现在 HID 订阅之后（避免 ATT 请求互相挤占）。
 */
static struct bt_gatt_discover_params bas_disc;
static struct bt_gatt_read_params bas_read;
static struct bt_gatt_subscribe_params bas_sub;
static uint16_t bas_value_handle;
static atomic_t batt_pct = ATOMIC_INIT(-1);

static void bas_work_handler(struct k_work *w);
K_WORK_DELAYABLE_DEFINE(bas_work, bas_work_handler);

/* 诊断计数（只打在这条 5 s 统计行里，避免被 CDC 控制台丢行）：
 *   sec_ok/sec_err：security_changed 的成功/失败次数
 *   disc_ok       ：特征发现的完成次数（on_char 收到 attr == NULL）
 *   sub_ok        ：bt_gatt_subscribe 返回 0 或 -EALREADY 的次数
 *   disc_evt      ：断链事件数
 */
static atomic_t sec_ok, sec_err, disc_ok, sub_ok, disc_evt;

/* BAS 诊断：发现成功、找到服务、找到特征、读成功、读失败 */
static atomic_t bas_disc_ok, bas_found, bas_char_ok, bas_read_ok, bas_read_err;
static uint8_t bas_tries;

/* 合成报告用的状态 */
static uint8_t cur_btn;
static int8_t cur_wheel;
static int8_t cur_pan;

static void start_scan(void);

/* LLPM（Nordic 私有低延迟模式）：两端都必须是 Nordic SDC 且都使能 LLPM。
 * 注意：LLPM 模式必须在**建链之前**使能（SDC 的行为），否则之后下发
 * 1 ms 间隔会返回 0x11 Unsupported Feature/Parameter。
 * 使能后可以用 vendor specific 的 conn_update 按**微秒**下发间隔，
 * 合法范围 1000..7000 us（1 ms 步进）。 */
static int llpm_mode_enable(void)
{
#if defined(CONFIG_BT_CTLR_SDC_LLPM)
	sdc_hci_cmd_vs_llpm_mode_set_t mode = { .enable = true };
	int err = hci_vs_sdc_llpm_mode_set(&mode);

	printk("ble: LLPM mode %s (%d)\n", err ? "failed" : "enabled", err);
	return err;
#else
	return -ENOTSUP;
#endif
}

static int llpm_try_interval(uint16_t handle, uint32_t interval_us)
{
	sdc_hci_cmd_vs_conn_update_t upd = {
		.conn_handle = handle,
		.conn_interval_us = interval_us,
		.conn_latency = 0,
		.supervision_timeout = 400,
	};

	int err = hci_vs_sdc_conn_update(&upd);

	printk("ble: LLPM %u us requested (handle %u) err %d\n",
	       interval_us, handle, err);
	return err;
}

static void llpm_apply(struct bt_conn *c)
{
#if defined(CONFIG_BT_CTLR_SDC_LLPM)
	uint16_t handle = 0;
	int err;

	if (bt_hci_get_conn_handle(c, &handle) != 0) {
		printk("ble: LLPM: no conn handle\n");
		return;
	}

	/* 先按标准参数更新走 LLPM 编码（0x0D00 + 毫秒数）：
	 * BT_CTLR_SDC_LLPM 会 select BT_CONN_PARAM_ANY，主机允许这种编码。
	 * 语法：interval_min/max 用 0x0D01 = 1 ms、0x0D02 = 2 ms。 */
	const struct bt_le_conn_param one_ms =
		BT_LE_CONN_PARAM_INIT(0x0D01, 0x0D01, 0, 400);

	err = bt_conn_le_param_update(c, &one_ms);
	printk("ble: LLPM 1 ms (0x0D01) param update request err %d\n", err);

	if (!err) {
		return;
	}

	/* 标准路径被拒再用 vendor specific 命令，实测这颗 SDC 接受 2 ms */
	if (llpm_try_interval(handle, 2000) == 0) {
		return;
	}

	if (llpm_try_interval(handle, 5000) == 0) {
		return;
	}

	(void)llpm_try_interval(handle, 7000);
#else
	ARG_UNUSED(c);
#endif
}

/* 连接建立瞬间鼠标自己会请求 7.5 ms（bt_conn_le_param_update），
 * 上一个参数更新过程没结束就再下发 1 ms，SDC 会返回 0x11。
 * 所以延后 500 ms 再切 LLPM。 */
static void llpm_work_handler(struct k_work *work)
{
	ARG_UNUSED(work);

	if (conn) {
		llpm_apply(conn);
	}
}

K_WORK_DELAYABLE_DEFINE(llpm_work, llpm_work_handler);


/* 扫描重试：连接/加密失败后不要立刻重扫，否则同一时刻反复
 * bt_conn_le_create() 会因为上一个连接对象还没释放而返回 -EINVAL。 */
static void scan_retry_handler(struct k_work *work)
{
	ARG_UNUSED(work);
	start_scan();
}

K_WORK_DELAYABLE_DEFINE(scan_retry_work, scan_retry_handler);

static void schedule_scan_retry(int delay_ms)
{
	(void)k_work_reschedule(&scan_retry_work, K_MSEC(delay_ms));
}


static void put_rep(uint8_t btn, int16_t dx, int16_t dy, int8_t wheel)
{
	uint8_t rep[REP_LEN];

	rep[0] = btn;
	rep[1] = (uint8_t)((uint16_t)dx & 0xFF);
	rep[2] = (uint8_t)(((uint16_t)dx >> 8) & 0xFF);
	rep[3] = (uint8_t)((uint16_t)dy & 0xFF);
	rep[4] = (uint8_t)(((uint16_t)dy >> 8) & 0xFF);
	rep[5] = (uint8_t)wheel;

	if (k_msgq_put(&rep_q, rep, K_NO_WAIT) != 0) {
		uint8_t drop[REP_LEN];

		(void)k_msgq_get(&rep_q, drop, K_NO_WAIT);
		(void)k_msgq_put(&rep_q, rep, K_NO_WAIT);
	}
}

/* 12 bit 有符号展开 */
static int16_t s12(uint16_t v)
{
	return (int16_t)((v & 0x0800) ? ((int32_t)v - 4096) : (int32_t)v);
}

static uint8_t on_notify(struct bt_conn *c, struct bt_gatt_subscribe_params *params,
			 const void *data, uint16_t length)
{
	ARG_UNUSED(c);

	if (!data || length == 0) {
		/* 订阅被注销 */
		return BT_GATT_ITER_STOP;
	}

	const uint8_t *d = (const uint8_t *)data;

	/* NCS 的 HIDS 发通知时 params.data = rep，**不带 Report ID**
	 * （hids.c 里 params.data = rep; params.len = rep->size）。
	 * 所以只能靠订阅时记录的 value_handle 区分两路报告：
	 *   rep_handles[0] = Report 1，载荷 [btn, wheel, pan]
	 *   rep_handles[1] = Report 2，载荷 [x_lo, y_lo/x_hi, y_hi]
	 */
	if (params->value_handle == rep_handles[0] && length >= 3) {
		uint8_t btn = (uint8_t)(d[0] & 0x1f);
		int8_t wheel = (int8_t)d[1];
		int8_t pan = (int8_t)d[2];

		cur_btn = btn;
		cur_wheel = wheel;
		cur_pan = pan;
		atomic_inc(&btn_cnt);
		/* 按键/滚轮变化单独发一包，位移为 0 */
		put_rep(btn, 0, 0, wheel);
	} else if (params->value_handle == rep_handles[1] && length >= 3) {
		uint16_t xr = (uint16_t)(d[0] | ((d[1] & 0x0F) << 8));
		uint16_t yr = (uint16_t)((d[1] >> 4) | (d[2] << 4));
		int16_t dx = s12(xr);
		int16_t dy = s12(yr);

		put_rep(cur_btn, dx, dy, 0);
	} else {
		atomic_inc(&rx_err);
		return BT_GATT_ITER_CONTINUE;
	}

	atomic_inc(&rx_total);
	atomic_set(&last_rx_ms, (atomic_val_t)k_uptime_get());
	return BT_GATT_ITER_CONTINUE;
}

static void subscribe_reports(void);

static uint8_t on_char(struct bt_conn *c, const struct bt_gatt_attr *attr,
		       struct bt_gatt_discover_params *params)
{
	if (!attr) {
		/* 特征发现结束 */
		atomic_inc(&disc_ok);
		printk("ble: HID report chars = %d\n", rep_cnt);
		subscribe_reports();
		return BT_GATT_ITER_STOP;
	}

	const struct bt_gatt_chrc *chrc = attr->user_data;

	if (bt_uuid_cmp(chrc->uuid, BT_UUID_HIDS_REPORT) == 0 &&
	    (chrc->properties & BT_GATT_CHRC_NOTIFY) && rep_cnt < ARRAY_SIZE(rep_handles)) {
		rep_handles[rep_cnt++] = chrc->value_handle;
	}

	return BT_GATT_ITER_CONTINUE;
}

static uint8_t on_primary(struct bt_conn *c, const struct bt_gatt_attr *attr,
			  struct bt_gatt_discover_params *params)
{
	if (!attr) {
		printk("ble: HID service not found\n");
		return BT_GATT_ITER_STOP;
	}

	const struct bt_gatt_service_val *svc = attr->user_data;

	hid_start = attr->handle;
	hid_end = svc->end_handle;
	printk("ble: HID service handles %u..%u\n", hid_start, hid_end);

	disc.uuid = NULL;
	disc.start_handle = hid_start + 1;
	disc.end_handle = hid_end;
	disc.type = BT_GATT_DISCOVER_CHARACTERISTIC;
	disc.func = on_char;

	int err = bt_gatt_discover(conn, &disc);

	if (err) {
		printk("ble: char discover failed %d\n", err);
	}

	return BT_GATT_ITER_STOP;
}

static void start_discovery(void)
{
	/* security_changed 可能在同一连接上连触发两次（L2/L3），
	 * 第二次再跑发现会与第一次共用 disc/rep_handles，把订阅搞成两份。 */
	if (disc_started) {
		return;
	}
	disc_started = true;

	rep_cnt = 0;
	sub_retries = 0;
	atomic_clear(&sub_failed);
	memset(&disc, 0, sizeof(disc));
	disc.uuid = BT_UUID_HIDS;
	disc.start_handle = 0x0001;
	disc.end_handle = 0xffff;
	disc.type = BT_GATT_DISCOVER_PRIMARY;
	disc.func = on_primary;

	int err = bt_gatt_discover(conn, &disc);

	if (err) {
		printk("ble: service discover failed %d\n", err);
	}
}

/* 订阅 CCCD 的最终结果只有这个回调能拿到：bt_gatt_subscribe() 返回 0
 * 只代表"请求已发出"。重连后鼠标正忙于 1 kHz 通知时，CCC 写入可能被对方
 * 拒绝，此时必须重试，否则那一路通知永远不会到达（实测：重连后按键全失效，
 * 位移正常，dongle 侧一条 btn 通知都收不到）。
 */
static void on_subscribed(struct bt_conn *c, uint8_t err,
			  struct bt_gatt_subscribe_params *params)
{
	ARG_UNUSED(c);

	printk("ble: sub result h=%u err=%u\n", params->value_handle, err);

	if (err) {
		/* 先把它从协议栈的订阅链表里摘掉：否则重试时 bt_gatt_subscribe()
		 * 会因"同一 params 已在链表里"直接返回 -EALREADY，CCC 永远不重写。 */
		(void)bt_gatt_unsubscribe(c, params);
		subs_started = false;
		atomic_set(&sub_failed, 1);
	}
}

static void sub_retry_handler(struct k_work *w)
{
	ARG_UNUSED(w);

	if (!conn || !atomic_get(&sub_failed)) {
		return;
	}
	if (sub_retries >= 8) {
		printk("ble: giving up resubscribe\n");
		return;
	}

	sub_retries++;
	atomic_clear(&sub_failed);
	printk("ble: resubscribe attempt %u\n", sub_retries);
	subscribe_reports();
}

K_WORK_DELAYABLE_DEFINE(sub_retry_work, sub_retry_handler);

static void subscribe_reports(void)
{
	/* 同一连接只订阅一次：重复订阅时第二次会命中 bt_gatt_subscribe() 的
	 * "同一 params 指针已在链表里"分支并直接返回 -EALREADY，而在此之前
	 * 清空 params 会把协议栈订阅链表的 next 指针打成 NULL，链表从此截断。 */
	if (subs_started) {
		return;
	}
	subs_started = true;

	for (int i = 0; i < rep_cnt; i++) {
		/* **不要 memset**：本对端是已绑定设备，断链时协议栈会保留订阅节点
		 * （remove_subscriptions 只清 SENT 标志），清零 node.next 会把链表截断，
		 * 结果是重连后一路通知还能分发、另一路永远收不到
		 * （实测：位移正常、按键全丢，且鼠标侧 bt_gatt_notify 仍返回 0）。
		 */
		subs[i].notify = on_notify;
		subs[i].subscribe = on_subscribed;
		subs[i].value_handle = rep_handles[i];
		/* HID Report 特征下 CCCD 紧跟特征值（Zephyr bt_hids 的描述符顺序） */
		subs[i].ccc_handle = rep_handles[i] + 1;
		subs[i].value = BT_GATT_CCC_NOTIFY;
		/* 标记为易失：断链时让协议栈把该订阅从链表里摘掉，
		 * 下次连接就由我们自己重新写 CCC，而不是靠协议栈"保留+自动重订阅"。
		 * 鼠标端的 CCC 是按连接重置的，这样每次都能确定地把两路都打开。
		 */
		atomic_set_bit(subs[i].flags, BT_GATT_SUBSCRIBE_FLAG_VOLATILE);

		int err = bt_gatt_subscribe(conn, &subs[i]);

		if (err && err != -EALREADY) {
			printk("ble: subscribe %d failed %d\n", i, err);
		} else {
			atomic_inc(&sub_ok);
			printk("ble: subscribed report %d (val %u)\n", i, rep_handles[i]);
		}
	}
	subscribed = true;
	/* 有结果回调报了错就过 300 ms 再试一次 */
	if (atomic_get(&sub_failed)) {
		k_work_reschedule(&sub_retry_work, K_MSEC(300));
	}

	/* HID 的 CCC 写完之后再去发现电量服务，避免两条 ATT 请求挤在一起 */
	(void)k_work_reschedule(&bas_work, K_MSEC(500));
}

/* ---- 电量（标准 Battery Service 0x180F / 0x2A19） ----
 * 鼠标把电量挂到 BAS 上（见鼠标 prj.conf 的 CONFIG_BT_BAS），
 * dongle 连上后先读一次当前值，再订阅后续变化，用来驱动红灯做低电提示。
 *
 * 注意：bas_sub 与 HID 的两路订阅一样不能 memset —— 已绑定对端断链时
 * 协议栈会保留订阅节点，清零会把链表截断（详见 subscribe_reports 的注释）。
 */
static uint8_t on_bas_notify(struct bt_conn *c,
			     struct bt_gatt_subscribe_params *params,
			     const void *data, uint16_t length)
{
	ARG_UNUSED(c);

	if (!data || length < 1) {
		return BT_GATT_ITER_STOP;
	}

	atomic_set(&batt_pct, ((const uint8_t *)data)[0]);
	atomic_inc(&bas_read_ok);
	return BT_GATT_ITER_CONTINUE;
}

static void on_bas_subscribed(struct bt_conn *c, uint8_t err,
			      struct bt_gatt_subscribe_params *params)
{
	ARG_UNUSED(c);

	printk("ble: bas sub h=%u err=%u\n", params->value_handle, err);
}

static uint8_t on_bas_read(struct bt_conn *c, uint8_t err,
			   struct bt_gatt_read_params *params,
			   const void *data, uint16_t length)
{
	ARG_UNUSED(c);
	ARG_UNUSED(params);

	if (err == 0 && data && length >= 1) {
		atomic_set(&batt_pct, ((const uint8_t *)data)[0]);
		atomic_inc(&bas_read_ok);
	} else {
		atomic_inc(&bas_read_err);
	}

	return BT_GATT_ITER_STOP;
}

static uint8_t on_bas_char(struct bt_conn *c, const struct bt_gatt_attr *attr,
			   struct bt_gatt_discover_params *params)
{
	if (!attr) {
		return BT_GATT_ITER_STOP;
	}

	const struct bt_gatt_chrc *chrc = attr->user_data;

	if (bt_uuid_cmp(chrc->uuid, BT_UUID_BAS_BATTERY_LEVEL) != 0) {
		return BT_GATT_ITER_CONTINUE;
	}

	bas_value_handle = chrc->value_handle;
	atomic_inc(&bas_char_ok);

	/* 先读一次：电量在连上后不一定马上变化，光订阅可能一直等不到通知 */
	memset(&bas_read, 0, sizeof(bas_read));
	bas_read.func = on_bas_read;
	bas_read.handle_count = 1;
	bas_read.single.handle = bas_value_handle;
	bas_read.single.offset = 0;
	(void)bt_gatt_read(c, &bas_read);

	if (chrc->properties & BT_GATT_CHRC_NOTIFY) {
		bas_sub.notify = on_bas_notify;
		bas_sub.subscribe = on_bas_subscribed;
		bas_sub.value_handle = bas_value_handle;
		bas_sub.ccc_handle = bas_value_handle + 1;
		bas_sub.value = BT_GATT_CCC_NOTIFY;
		atomic_set_bit(bas_sub.flags, BT_GATT_SUBSCRIBE_FLAG_VOLATILE);

		int err = bt_gatt_subscribe(c, &bas_sub);

		if (err && err != -EALREADY) {
			printk("ble: bas subscribe failed %d\n", err);
		}
	}

	printk("ble: BAS level handle %u\n", bas_value_handle);
	return BT_GATT_ITER_STOP;
}

static uint8_t on_bas_primary(struct bt_conn *c, const struct bt_gatt_attr *attr,
			      struct bt_gatt_discover_params *params)
{
	if (!attr) {
		printk("ble: no BAS service\n");
		return BT_GATT_ITER_STOP;
	}

	const struct bt_gatt_service_val *svc = attr->user_data;

	atomic_inc(&bas_found);

	/* 与 HID 那一路保持一致：**不带 UUID 过滤**，列出该服务下所有特征，
	 * 再在回调里比对 UUID。实测带 uuid 过滤的特征发现会静默失败
	 * （bt_gatt_discover 直接返回错误、回调一次都没进来）。 */
	params->uuid = NULL;
	params->start_handle = attr->handle + 1;
	params->end_handle = svc->end_handle;
	params->type = BT_GATT_DISCOVER_CHARACTERISTIC;
	params->func = on_bas_char;

	int err = bt_gatt_discover(c, params);

	if (err) {
		printk("ble: bas char discover failed %d\n", err);
	}

	return BT_GATT_ITER_STOP;
}

static void bas_work_handler(struct k_work *w)
{
	ARG_UNUSED(w);

	if (!conn) {
		return;
	}

	/* 已经读到电量就不用再折腾；最多试 8 次（每次间隔 3 s） */
	if (atomic_get(&batt_pct) >= 0 || bas_tries >= 8) {
		return;
	}
	bas_tries++;

	memset(&bas_disc, 0, sizeof(bas_disc));
	bas_disc.uuid = BT_UUID_BAS;
	bas_disc.start_handle = 0x0001;
	bas_disc.end_handle = 0xffff;
	bas_disc.type = BT_GATT_DISCOVER_PRIMARY;
	bas_disc.func = on_bas_primary;

	int err = bt_gatt_discover(conn, &bas_disc);

	if (err) {
		atomic_inc(&bas_read_err);
		printk("ble: bas discover failed %d\n", err);
	} else {
		atomic_inc(&bas_disc_ok);
	}

	/* 本轮没拿到值就 3 s 后再来一次（ATT 请求可能正忙） */
	(void)k_work_reschedule(&bas_work, K_MSEC(3000));
}

static void connected(struct bt_conn *conn_, uint8_t err)
{
	if (err) {
		printk("ble: connect failed 0x%02x\n", err);
		if (conn) {
			bt_conn_unref(conn);
			conn = NULL;
		}
		schedule_scan_retry(300);
		return;
	}

	/* bt_conn_le_create() 返回的对象引用已经由我们持有（存在 conn 里），
	 * 这里不能再 ref，否则 disconnected() 只 unref 一次会漏掉一个引用，
	 * 连接对象会卡在 disconnected 状态，之后 bt_conn_le_create() 一直 -EINVAL。 */
	if (!conn) {
		conn = bt_conn_ref(conn_);
	}
	/* 新连接：允许重新发现 / 重新订阅 */
	disc_started = false;
	subs_started = false;
	bas_tries = 0;
	printk("ble: connected\n");
	printk("ble: requesting L2 security\n");
	(void)bt_conn_set_security(conn, BT_SECURITY_L2);
}

static void disconnected(struct bt_conn *conn_, uint8_t reason)
{
	ARG_UNUSED(conn_);
	atomic_inc(&disc_evt);
	printk("ble: disconnected 0x%02x\n", reason);

	if (conn) {
		bt_conn_unref(conn);
		conn = NULL;
	}
	subscribed = false;
	/* 断链后电量未知：红灯保持灭，避免显示过期数值 */
	atomic_set(&batt_pct, -1);
	(void)k_work_cancel_delayable(&bas_work);
	/* 稍等再扫：等协议栈释放完上一个连接对象 */
	schedule_scan_retry(300);
}

static void security_changed(struct bt_conn *conn_, bt_security_t level, enum bt_security_err err)
{
	if (err) {
		printk("ble: security failed %d -> unpair, retry fresh\n", err);
		atomic_inc(&sec_err);
		/* 配对信息对不上（例如鼠标被重烧/被别的主机重新配对过）时，
		 * 清掉本端这条过期 bond 再重连，下次走全新配对，避免永远卡在加密阶段。 */
		(void)bt_unpair(BT_ID_DEFAULT, bt_conn_get_dst(conn_));
		(void)bt_conn_disconnect(conn_, BT_HCI_ERR_AUTH_FAIL);
		return;
	}
	printk("ble: security level %d\n", level);

	if (level >= BT_SECURITY_L2 && !subscribed) {
		atomic_inc(&sec_ok);
		/* 加密完成后先发现/订阅 HID；LLPM 1 ms 延后 500 ms 再切，
		 * 避免和鼠标自己刚发的 7.5 ms 参数更新撞车（会得到 0x11）。 */
		(void)k_work_reschedule(&llpm_work, K_MSEC(500));
		start_discovery();
	}
}

BT_CONN_CB_DEFINE(ctr_conn_cb) = {
	.connected = connected,
	.disconnected = disconnected,
	.security_changed = security_changed,
};

static bool name_found;

static bool adv_name_cb(struct bt_data *data, void *user)
{
	ARG_UNUSED(user);

	if (data->type != BT_DATA_NAME_COMPLETE && data->type != BT_DATA_NAME_SHORTENED) {
		return true;
	}

	const size_t want = sizeof(BLE_CTR_TARGET_NAME) - 1;

	if (data->data_len == want &&
	    memcmp(data->data, BLE_CTR_TARGET_NAME, want) == 0) {
		name_found = true;
		return false;
	}
	return true;
}

static void scan_cb(const bt_addr_le_t *addr, int8_t rssi, uint8_t adv_type,
		    struct net_buf_simple *buf)
{
	ARG_UNUSED(rssi);
	ARG_UNUSED(adv_type);

	if (name_found) {
		return;
	}

	/* 名字可能出现在广播包（ADV_IND）或扫描响应（SCAN_RSP）里，
	 * 两处都要检查；能回扫描响应的设备都是可连接的。 */
	name_found = false;
	bt_data_parse(buf, adv_name_cb, NULL);

	if (!name_found) {
		return;
	}

	printk("ble: found \"%s\", connecting\n", BLE_CTR_TARGET_NAME);
	(void)bt_le_scan_stop();

	int err = bt_conn_le_create(addr, BT_CONN_LE_CREATE_CONN,
				    BT_LE_CONN_PARAM(6, 6, 0, 400), &conn);

	if (err) {
		printk("ble: create conn failed %d\n", err);
		if (conn) {
			bt_conn_unref(conn);
			conn = NULL;
		}
		schedule_scan_retry(300);
	}
}

static void start_scan(void)
{
	static const struct bt_le_scan_param param = {
		/* 主动扫描：鼠标的设备名很可能只在 scan response 里 */
		.type = BT_LE_SCAN_TYPE_ACTIVE,
		.options = BT_LE_SCAN_OPT_NONE,
		.interval = BT_GAP_SCAN_FAST_INTERVAL,
		.window = BT_GAP_SCAN_FAST_WINDOW,
	};

	name_found = false;
	int err = bt_le_scan_start(&param, scan_cb);

	if (err) {
		printk("ble: scan start failed %d\n", err);
	}
}

void ble_ctr_stats(uint32_t *total, uint32_t *err)
{
	*total = (uint32_t)atomic_get(&rx_total);
	*err = (uint32_t)atomic_get(&rx_err);
}

uint32_t ble_ctr_btn_count(void)
{
	return (uint32_t)atomic_get(&btn_cnt);
}

int64_t ble_ctr_last_ms(void)
{
	return (int64_t)atomic_get(&last_rx_ms);
}

bool ble_ctr_ready(void)
{
	return subscribed;
}

int ble_ctr_battery_level(void)
{
	return (int)atomic_get(&batt_pct);
}

void ble_ctr_diag(uint32_t *sec_ok_, uint32_t *sec_err_, uint32_t *disc_ok_,
		  uint32_t *sub_ok_, uint32_t *disc_evt_)
{
	*sec_ok_ = (uint32_t)atomic_get(&sec_ok);
	*sec_err_ = (uint32_t)atomic_get(&sec_err);
	*disc_ok_ = (uint32_t)atomic_get(&disc_ok);
	*sub_ok_ = (uint32_t)atomic_get(&sub_ok);
	*disc_evt_ = (uint32_t)atomic_get(&disc_evt);
}

void ble_ctr_bas_diag(uint32_t *disc_ok_, uint32_t *found_, uint32_t *chr_,
		      uint32_t *rd_ok_, uint32_t *rd_err_)
{
	*disc_ok_ = (uint32_t)atomic_get(&bas_disc_ok);
	*found_ = (uint32_t)atomic_get(&bas_found);
	*chr_ = (uint32_t)atomic_get(&bas_char_ok);
	*rd_ok_ = (uint32_t)atomic_get(&bas_read_ok);
	*rd_err_ = (uint32_t)atomic_get(&bas_read_err);
}

int ble_ctr_cfg_send(const uint8_t *data, uint8_t len)
{
	ARG_UNUSED(data);
	ARG_UNUSED(len);

	/* 鼠标端 BLE 侧还没有配置特征（只有 HID + BAS），
	 * 等它加上厂商配置服务后，这里改成 bt_gatt_write_without_response。 */
	return -ENOTSUP;
}

static void bond_info_cb(const struct bt_bond_info *info, void *user_data)
{
	char addr[BT_ADDR_LE_STR_LEN];

	ARG_UNUSED(user_data);
	bt_addr_le_to_str(&info->addr, addr, sizeof(addr));
	printk("ble: stored bond %s\n", addr);
}

int ble_ctr_init(void)
{
	int err = bt_enable(NULL);

	if (err) {
		printk("ble: bt_enable failed %d\n", err);
		return err;
	}

	/* 载入已保存的配对信息（LTK/IRK）。必须放在 bt_enable 之后。 */
	if (IS_ENABLED(CONFIG_SETTINGS)) {
		err = settings_load();
		if (err) {
			printk("ble: settings_load failed %d\n", err);
		}
		bt_foreach_bond(BT_ID_DEFAULT, bond_info_cb, NULL);
	}

	/* LLPM 模式必须在建链前打开 */
	(void)llpm_mode_enable();

	printk("ble: central up, scanning for \"%s\"\n", BLE_CTR_TARGET_NAME);
	start_scan();

	return 0;
}
```

## src/ble_ctr.h
```c
/*
 * BLE Central 接收层（dongle 侧）
 *
 * 思路：dongle 自己当 BLE 主机去连接鼠标，收 HID Report 通知，
 * 再转成 USB HID 报告发给电脑。这样电脑只需看到一个普通 USB 鼠标，
 * 完全不经过 Windows 的蓝牙栈。
 *
 * 连接间隔由本端（Central）请求，先要 7.5 ms；后续可换 Nordic LLPM 1 ms。
 */
#ifndef BLE_CTR_H__
#define BLE_CTR_H__

#include <stdint.h>
#include <stdbool.h>

/* 鼠标广播名（与鼠标端 CONFIG_BT_DEVICE_NAME 一致） */
#define BLE_CTR_TARGET_NAME "XIAO Mouse"

int ble_ctr_init(void);

/* 统计：total = 累计收到的 HID 通知数，err = 解析异常数 */
void ble_ctr_stats(uint32_t *total, uint32_t *err);

/* 累计收到的"按键报告"(Report 1)通知数，用于区分按键链路丢在哪一段 */
uint32_t ble_ctr_btn_count(void);

/* 最近一次收到通知的时刻（k_uptime ms）；从未收到返回 0 */
int64_t ble_ctr_last_ms(void);

/* 当前是否已连接（含已完成订阅） */
bool ble_ctr_ready(void);

/* 鼠标电量百分比（来自标准 Battery Service 0x180F/0x2A19）。
 * 未连接或还没读到返回 -1。主循环据此驱动红灯（<=25% 常亮）。
 */
int ble_ctr_battery_level(void);

/* 诊断计数：安全成功/失败、特征发现完成、订阅成功、断链事件。
 * 只用于打在 5 s 统计行里（CDC 控制台会丢零散日志行）。
 */
void ble_ctr_diag(uint32_t *sec_ok, uint32_t *sec_err, uint32_t *disc_ok,
		  uint32_t *sub_ok, uint32_t *disc_evt);

/* BAS 诊断：发现成功 / 找到服务 / 找到特征 / 读成功 / 读失败 */
void ble_ctr_bas_diag(uint32_t *disc_ok, uint32_t *found, uint32_t *chr,
		      uint32_t *rd_ok, uint32_t *rd_err);

/* 下发配置命令。鼠标端目前只有标准 HID/BAS 服务，没有配置特征，
 * 所以恒返回 -ENOTSUP（设置只保存在 dongle，2.4G 变体才真正下发）。
 */
int ble_ctr_cfg_send(const uint8_t *data, uint8_t len);

#endif /* BLE_CTR_H__ */
```

## src/esb_rx.c
```c
/*
 * ESB PRX 接收层实现（dongle 侧，NCS v3.4 ESB/MPSL API）
 *
 * 收包在 ESB 事件回调（中断上下文）里解析后塞进 rep_q，
 * main 循环里取出来提交 HID。位移不做累计——ESB 是 1 ms 级链路，
 * 丢包直接丢（下一段位移自然接上），这与 BLE 的"攒着补发"策略不同。
 *
 * 【诊断版】每 5 秒打印 NRF_RADIO->STATE，验证 PRX 的 radio 是否真的
 * 处于接收状态（STATE: 0=DISABLED 1=RXRU 2=RXIDLE 3=RX 4=TXRU 5=TXIDLE 6=TX）。
 */

#include <esb.h>

#include <string.h>
#include <errno.h>

#include <zephyr/kernel.h>
#include <zephyr/sys/printk.h>
#include <zephyr/sys/atomic.h>
#include <zephyr/sys/util.h>
#include <zephyr/toolchain.h>

#include <nrfx.h>

#include "esb_rx.h"

/* 诊断打印开关（与 main.c 的 APP_VERBOSE_LOG 同名，默认关闭）。
 * 下面的 5 s radio 寄存器转储和 rssi_live() 会直接操作 NRF_RADIO：
 * 在 PRX 正在收包时反复 RSSISTART 会干扰接收，正式固件必须关掉。 */
#ifndef APP_VERBOSE_LOG
#define APP_VERBOSE_LOG 0
#endif

/* 与 main.c 共享的 HID 报告队列（6 字节：btn, dxL, dxH, dyL, dyH, wheel） */
extern struct k_msgq rep_q;

static atomic_t rx_total;
static atomic_t rx_err;
static atomic_t rx_gap;
static atomic_t last_rx_ms;

/* 鼠标电量：搭在负载 data[9] 上随包回传，0 = 未知 */
static atomic_t batt_pct = ATOMIC_INIT(0);
static atomic_t batt_ms;

#define BATT_STALE_MS 30000

static uint8_t expected_seq;

/* 滚轮累计计数解算：鼠标每包带 16 bit wheel_total，这里算增量。
 * 超过 WHEEL_RESYNC_MS 没收到包（鼠标睡着/重启/换电池）就重新对齐，
 * 避免上电瞬间把旧计数差当成一次大滚动。 */
#define WHEEL_RESYNC_MS 1500
static uint16_t wheel_last;   /* 模 65536，回绕定义明确 */
static bool wheel_synced;

#if APP_VERBOSE_LOG
static uint8_t g_selftest[80];
static uint8_t g_selftest_min;
static uint8_t g_selftest_min_ch;

/* 现场重新采样一次 ch46 的 RSSI（避开开机日志被丢弃的问题） */
static uint8_t rssi_live(void)
{
	uint8_t mn = 0xFF;

	for (int i = 0; i < 20; i++) {
		NRF_RADIO->TASKS_RSSISTART = 1;
		k_busy_wait(10);
		uint8_t v = (uint8_t)NRF_RADIO->RSSISAMPLE;

		if ((v != 0) && (v < mn)) {
			mn = v;
		}
	}
	return mn;
}

/*
 * 诊断：裸 radio 接收自检（完全脱离 ESB）。
 * 把 radio 置于原始 RX，扫 0~79 信道，记录每个信道的最强 RSSI 采样。
 * RSSISAMPLE 读数是 |dBm|（40 = -40 dBm），越小越强，0 视为无效。
 * 环境里必有 Wi-Fi，若全频段都停在 ~100 说明接收前端没工作。
 */
static void radio_rx_selftest(void)
{
	uint8_t mn_all = 0xFF;
	uint8_t ch_all = 0;

	NRF_RADIO->TASKS_DISABLE = 1;
	NRF_RADIO->POWER = 1;
	NRF_RADIO->MODE = 1;          /* Nrf_2Mbit，RSSI 测量与速率无关 */
	NRF_RADIO->PCNF0 = 0;
	NRF_RADIO->PCNF1 = 0;
	NRF_RADIO->RXADDRESSES = 0;
	NRF_RADIO->CRCCNF = 0;        /* 关 CRC，只测能量 */
	NRF_RADIO->SHORTS = 0;
	NRF_RADIO->EVENTS_READY = 0;
	NRF_RADIO->TASKS_RXEN = 1;
	k_busy_wait(200);

	for (int ch = 0; ch < 80; ch++) {
		uint8_t mn = 0xFF;

		NRF_RADIO->FREQUENCY = (uint32_t)ch;
		k_busy_wait(150);

		for (int i = 0; i < 20; i++) {
			NRF_RADIO->TASKS_RSSISTART = 1;
			k_busy_wait(10);
			uint8_t v = (uint8_t)NRF_RADIO->RSSISAMPLE;

			if ((v != 0) && (v < mn)) {
				mn = v;
			}
		}
		g_selftest[ch] = mn;

		if (mn < mn_all) {
			mn_all = mn;
			ch_all = (uint8_t)ch;
		}
	}

	NRF_RADIO->TASKS_DISABLE = 1;

	g_selftest_min = mn_all;
	g_selftest_min_ch = ch_all;

	printk("rf: selftest min=%u@ch%u | ch0=%u ch20=%u ch37=%u ch46=%u ch60=%u ch79=%u\n",
	       (unsigned int)mn_all, (unsigned int)ch_all,
	       (unsigned int)g_selftest[0], (unsigned int)g_selftest[20],
	       (unsigned int)g_selftest[37], (unsigned int)g_selftest[46],
	       (unsigned int)g_selftest[60], (unsigned int)g_selftest[79]);
}

/* 每 5 秒打印 radio STATE（定时器回调 = 系统时钟上下文，printk 安全） */
static void stat_timer_fn(struct k_timer *t)
{
	ARG_UNUSED(t);
	printk("esb: PRX rx %u total, gap %u, err %u radio STATE=0x%02X ADDR=%u CRCOK=%u CRCERR=%u END=%u RSSI=%u\n",
	       (unsigned int)atomic_get(&rx_total),
	       (unsigned int)atomic_get(&rx_gap),
	       (unsigned int)atomic_get(&rx_err),
	       (unsigned int)NRF_RADIO->STATE,
	       (unsigned int)NRF_RADIO->EVENTS_ADDRESS,
	       (unsigned int)NRF_RADIO->EVENTS_CRCOK,
	       (unsigned int)NRF_RADIO->EVENTS_CRCERROR,
	       (unsigned int)NRF_RADIO->EVENTS_END,
	       (unsigned int)NRF_RADIO->RSSISAMPLE);
	printk("rf: selftest min=%u@ch%u | ch0=%u ch20=%u ch37=%u ch46=%u ch60=%u ch79=%u | live(ch46)=%u\n",
	       (unsigned int)g_selftest_min, (unsigned int)g_selftest_min_ch,
	       (unsigned int)g_selftest[0], (unsigned int)g_selftest[20],
	       (unsigned int)g_selftest[37], (unsigned int)g_selftest[46],
	       (unsigned int)g_selftest[60], (unsigned int)g_selftest[79],
	       (unsigned int)rssi_live());
	printk("esb: rx radio FREQ=%u MODE=0x%X PCNF0=0x%08X PCNF1=0x%08X CRCCNF=0x%X POLY=0x%X INIT=0x%X BASE0=0x%08X PFX0=0x%08X RXADDRS=0x%X\n",
	       (unsigned int)NRF_RADIO->FREQUENCY,
	       (unsigned int)NRF_RADIO->MODE,
	       (unsigned int)NRF_RADIO->PCNF0,
	       (unsigned int)NRF_RADIO->PCNF1,
	       (unsigned int)NRF_RADIO->CRCCNF,
	       (unsigned int)NRF_RADIO->CRCPOLY,
	       (unsigned int)NRF_RADIO->CRCINIT,
	       (unsigned int)NRF_RADIO->BASE0,
	       (unsigned int)NRF_RADIO->PREFIX0,
	       (unsigned int)NRF_RADIO->RXADDRESSES);
}

static K_TIMER_DEFINE(stat_timer, stat_timer_fn, NULL);
#endif /* APP_VERBOSE_LOG */

static void parse_payload(const struct esb_payload *pl)
{
	uint8_t rep[6];
	int64_t now;
	int64_t prev;
	int32_t wheel_delta = 0;
	uint16_t wheel_total;

	if (pl->length != ESB_PAYLOAD_LEN) {
		atomic_inc(&rx_err);
		return;
	}

	now = k_uptime_get();
	prev = (int64_t)atomic_get(&last_rx_ms);

	/* data[6..7] = 鼠标端滚轮累计计数（uint16 LE），不是相对量。
	 * 丢包后下一包会把漏掉的格数一起带过来；重复包差值为 0。 */
	wheel_total = (uint16_t)(pl->data[6] | (pl->data[7] << 8));
	if (!wheel_synced || prev == 0 || (now - prev) > WHEEL_RESYNC_MS) {
		wheel_last = wheel_total;
		wheel_synced = true;
	} else {
		int32_t d = (int16_t)(wheel_total - wheel_last);

		wheel_delta = CLAMP(d, -127, 127);
		/* 只推进实际发出的量，超出 ±127 的部分留给下一包。
		 * 用 uint16 回绕，避免累计到边界时出现有符号溢出。 */
		wheel_last = (uint16_t)(wheel_last + wheel_delta);
	}

	rep[0] = pl->data[1];                 /* btn */
	rep[1] = pl->data[2];                 /* dx 低字节 */
	rep[2] = pl->data[3];                 /* dx 高字节 */
	rep[3] = pl->data[4];                 /* dy 低字节 */
	rep[4] = pl->data[5];                 /* dy 高字节 */
	rep[5] = (uint8_t)(int8_t)wheel_delta; /* 本次应滚动的格数 */

	/* 丢包只计数，不打印——1 kHz 下每包一行 printk 会拖死中断 */
	if (pl->data[0] != expected_seq) {
		atomic_inc(&rx_gap);
	}
	expected_seq = (uint8_t)(pl->data[0] + 1);

	atomic_inc(&rx_total);
	atomic_set(&last_rx_ms, (atomic_val_t)now);

	/* data[9] = 电量百分比（1..100）。0/0xFF 视为未知，避免旧固件
	 * 全 0 负载被误判成 0% 而点亮低电红灯。 */
	if (pl->data[9] > 0 && pl->data[9] <= 100) {
		atomic_set(&batt_pct, pl->data[9]);
		atomic_set(&batt_ms, (atomic_val_t)k_uptime_get());
	}

	/* 队列满就丢最旧的包——鼠标位移只关心最新状态 */
	if (k_msgq_put(&rep_q, rep, K_NO_WAIT) != 0) {
		uint8_t drop[6];

		(void)k_msgq_get(&rep_q, drop, K_NO_WAIT);
		(void)k_msgq_put(&rep_q, rep, K_NO_WAIT);
	}
}

static void esb_event_cb(const struct esb_evt *evt)
{
	struct esb_payload pl;

	switch (evt->evt_id) {
	case ESB_EVENT_RX_RECEIVED:
		while (esb_read_rx_payload(&pl) == 0) {
			parse_payload(&pl);
		}
		break;
	case ESB_EVENT_TX_SUCCESS:
	case ESB_EVENT_TX_FAILED:
		/* PRX 不会发这些事件（未启用 ACK payload） */
		break;
	default:
		printk("esb: evt %d\n", evt->evt_id);
		break;
	}
}

void esb_rx_stats(uint32_t *total, uint32_t *err)
{
	*total = atomic_get(&rx_total);
	*err = atomic_get(&rx_err);
}

int64_t esb_rx_last_ms(void)
{
	return (int64_t)atomic_get(&last_rx_ms);
}

int esb_rx_battery_level(void)
{
	int pct = (int)atomic_get(&batt_pct);
	int64_t t = (int64_t)atomic_get(&batt_ms);

	if (pct <= 0) {
		return -1;
	}
	if ((k_uptime_get() - t) > BATT_STALE_MS) {
		return -1;
	}
	return pct;
}

/*
 * PRX 方向的 ACK payload：鼠标（PTX）每发一个包都会请求 ACK，
 * 这里塞进队列的数据就搭在 ACK 上回给鼠标。
 * 队列深度有限（CONFIG_ESB_ACK_FIFO_SIZE），满了返回 -ENOMEM，
 * 上层会重发，不需要在这里重试。
 */
int esb_rx_cfg_send(const uint8_t *data, uint8_t len)
{
	struct esb_payload pl = { .length = len };

	if (len > sizeof(pl.data)) {
		return -EINVAL;
	}

	memcpy(pl.data, data, len);

	return esb_write_payload(&pl);
}

int esb_rx_init(void)
{
	static const uint8_t base[4] = ESB_ADDR_BASE;
	static const uint8_t prefix = ESB_ADDR_PREFIX;
	struct esb_config cfg = ESB_DEFAULT_CONFIG;
	int err;

#if APP_VERBOSE_LOG
	/* 诊断：先做裸 radio 接收自检（此时 ESB 尚未接管 radio）。
	 * 会扫全频段，约 30 ms，正式固件不跑。 */
	radio_rx_selftest();
#endif

	cfg.mode = ESB_MODE_PRX;
	cfg.event_handler = esb_event_cb;
	cfg.retransmit_count = 2;   /* PRX 不重传，仅占位 */
	cfg.retransmit_delay = 600;
	cfg.tx_output_power = 0;    /* RX-only，无意义，占位 */
	cfg.selective_auto_ack = false;

	err = esb_init(&cfg);
	if (err) {
		printk("esb: init failed %d\n", err);
		return err;
	}

	err = esb_set_base_address_0(base);
	if (err) {
		printk("esb: base addr failed %d\n", err);
		return err;
	}

	err = esb_set_prefixes(&prefix, 1);
	if (err) {
		printk("esb: prefix failed %d\n", err);
		return err;
	}

	err = esb_set_rf_channel(ESB_RF_CHANNEL);
	if (err) {
		printk("esb: channel failed %d\n", err);
		return err;
	}

	err = esb_start_rx();
	if (err) {
		printk("esb: start_rx failed %d\n", err);
		return err;
	}

#if APP_VERBOSE_LOG
	/* 诊断：每次地址匹配自动测 RSSI（不干扰 ESB 自身 shorts） */
	NRF_RADIO->SHORTS |= NRF_RADIO_SHORT_ADDRESS_RSSISTART_MASK;

	k_timer_start(&stat_timer, K_SECONDS(5), K_SECONDS(5));
#endif

	printk("esb: PRX started ch=%u addr=A5:3C:9D:71:%02X 2Mbps\n",
	       ESB_RF_CHANNEL, ESB_ADDR_PREFIX);

	return 0;
}
```

## src/esb_rx.h
```c
/*
 * ESB PRX 接收层（dongle 侧）
 *
 * 2.4G 私有协议：Nordic ESB（Enhanced ShockBurst）
 *   2 Mbps / 信道 75（2475 MHz）/ 16bit CRC / 固定 10 字节负载
 *   地址：base0 = A5:3C:9D:71，prefix = 2E
 *
 * 负载布局（与鼠标端 esb_ptx.c 共用约定）：
 *   [0] seq       包序号（丢包/乱序观测用）
 *   [1] btn       按键位图（bit0=左键 bit1=右键 bit2=中键，与 HID 报告一致）
 *   [2..3] dx     int16 小端位移
 *   [4..5] dy     int16 小端位移
 *   [6..7] wheel  int16 小端 **累计计数**（不是相对量）
 *                 接收器用"本包计数 - 上次计数"得到滚动格数；丢包后下一包
 *                 自动补齐，重复包差值为 0，不会重复滚动。
 *   [8]           保留（0）
 *   [9] batt      电量百分比（1..100，0xFF/0 = 未知）
 */
#ifndef ESB_RX_H__
#define ESB_RX_H__

#include <stdint.h>
#include <stdbool.h>

/* 信道 75 = 2475 MHz：避开邻居 Wi-Fi 信道 6（2426~2448 MHz）和
 * 信道 11（2451~2473 MHz）。必须与鼠标端 esb_ptx.c 的 ESB_RF_CHANNEL 一致。
 */
#define ESB_RF_CHANNEL   75
#define ESB_PAYLOAD_LEN  10
/* 地址 5 字节，鼠标端必须一致 */
#define ESB_ADDR_BASE    { 0xA5, 0x3C, 0x9D, 0x71 }
#define ESB_ADDR_PREFIX  0x2E

int esb_rx_init(void);

/* 统计：total = 累计正确收包数，err = CRC/长度异常包数 */
void esb_rx_stats(uint32_t *total, uint32_t *err);

/* 最近一次收包时刻（k_uptime_ms）；从未收包返回 0 */
int64_t esb_rx_last_ms(void);

/* 鼠标回传的电量百分比；超过 30 s 没更新或从未收到返回 -1 */
int esb_rx_battery_level(void);

/* 把一包配置命令塞进 PRX 的 ACK payload 队列（鼠标端在 RX_RECEIVED 事件里收）。
 * 队列空/已初始化失败时返回负 errno。
 */
int esb_rx_cfg_send(const uint8_t *data, uint8_t len);

#endif /* ESB_RX_H__ */
```
